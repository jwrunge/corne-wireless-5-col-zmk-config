## config/west.yml
```yaml
manifest:
  remotes:
    - name: zmkfirmware
      url-base: https://github.com/zmkfirmware
    - name: jwrunge
      url-base: https://github.com/jwrunge
  projects:
    - name: zmk
      remote: jwrunge
      revision: main
      import: app/west.yml
  self:
    path: config
```
